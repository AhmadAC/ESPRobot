## sdkconfig.defaults
```kconfig
CONFIG_FREERTOS_HZ=1000
CONFIG_ESP_CONSOLE_USB_SERIAL_JTAG=y
CONFIG_ESP_CONSOLE_SECONDARY_NONE=y

# Enable NimBLE Bluetooth Engine
CONFIG_BT_ENABLED=y
CONFIG_BT_NIMBLE_ENABLED=y

# Custom Partition Table
CONFIG_PARTITION_TABLE_CUSTOM=y
CONFIG_PARTITION_TABLE_CUSTOM_FILENAME="partitions.csv"
CONFIG_PARTITION_TABLE_FILENAME="partitions.csv"
CONFIG_PARTITION_TABLE_OFFSET=0x8000

# Configure for N8 (8MB Physical Flash)
CONFIG_ESPTOOLPY_FLASHSIZE_8MB=y
CONFIG_ESPTOOLPY_FLASHSIZE="8MB"

# HTTP Server tolerances for poor Wi-Fi and corporate proxies
CONFIG_HTTPD_MAX_REQ_HDR_LEN=4096
CONFIG_HTTPD_MAX_URI_LEN=1024

# CRITICAL FIX: Increase LwIP Sockets to handle Captive Portal background spam + UI Polling
CONFIG_LWIP_MAX_SOCKETS=16
```
